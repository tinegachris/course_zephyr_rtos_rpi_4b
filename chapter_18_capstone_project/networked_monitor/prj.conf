## prj.conf
```kconfig
# Kernel
CONFIG_MULTITHREADING=y
CONFIG_MAIN_STACK_SIZE=2048
CONFIG_SYSTEM_WORKQUEUE_STACK_SIZE=2048

# Logging
CONFIG_LOG=y
CONFIG_LOG_DEFAULT_LEVEL=3

# I2C
CONFIG_I2C=y

# BME280 Sensor
CONFIG_SENSOR=y
CONFIG_BME280=y

# Networking
CONFIG_NETWORKING=y
CONFIG_NET_TCP=y
CONFIG_NET_SOCKETS=y
CONFIG_NET_CONFIG_SETTINGS=y
CONFIG_NET_CONFIG_IEEE802154_DEV_NAME="" # Disable 802.15.4
CONFIG_NET_CONFIG_MY_IPV4_ADDR="192.168.1.100"
CONFIG_NET_CONFIG_MY_IPV4_NETMASK="255.255.255.0"
CONFIG_NET_CONFIG_MY_IPV4_GW="192.168.1.1"

# Power Management
CONFIG_PM=y
CONFIG_PM_DEVICE=y

# Shell
CONFIG_SHELL=y
CONFIG_SHELL_BACKEND_SERIAL=y
```

## src/main.c
```c
#include <zephyr/kernel.h>
#include "sensor_manager.h"
#include "web_server.h"

/* Shared data and mutex */
struct sensor_reading latest_reading;
K_MUTEX_DEFINE(data_mutex);

K_THREAD_DEFINE(sensor_tid, 1024, sensor_thread, NULL, NULL, NULL, 7, 0, 0);
K_THREAD_DEFINE(web_server_tid, 2048, web_server_thread, NULL, NULL, NULL, 7, 0, 0);

void main(void)
{
    /* The threads are started automatically by K_THREAD_DEFINE */
}
```

## src/sensor_manager.c
```c
#include <zephyr/kernel.h>
#include <zephyr/device.h>
#include <zephyr/drivers/sensor.h>
#include <zephyr/logging/log.h>
#include "sensor_manager.h"

LOG_MODULE_REGISTER(sensor_manager, LOG_LEVEL_INF);

extern struct sensor_reading latest_reading;
extern struct k_mutex data_mutex;

static const struct device *const bme280 = DEVICE_DT_GET_ANY(bosch_bme280);

void sensor_thread(void)
{
    struct sensor_reading data;
    int ret;

    if (!device_is_ready(bme280)) {
        LOG_ERR("BME280 device not ready");
        return;
    }

    LOG_INF("Sensor thread started, polling every 5 seconds");

    while (1) {
        /* Fetch sensor sample */
        ret = sensor_sample_fetch(bme280);
        if (ret < 0) {
            LOG_ERR("Failed to fetch sensor sample: %d", ret);
            k_sleep(K_SECONDS(5));
            continue;
        }

        /* Get temperature reading */
        ret = sensor_channel_get(bme280, SENSOR_CHAN_AMBIENT_TEMP, &data.temp);
        if (ret < 0) {
            LOG_ERR("Failed to get temperature: %d", ret);
            k_sleep(K_SECONDS(5));
            continue;
        }

        /* Get pressure reading */
        ret = sensor_channel_get(bme280, SENSOR_CHAN_PRESS, &data.press);
        if (ret < 0) {
            LOG_ERR("Failed to get pressure: %d", ret);
            k_sleep(K_SECONDS(5));
            continue;
        }

        /* Get humidity reading */
        ret = sensor_channel_get(bme280, SENSOR_CHAN_HUMIDITY, &data.humidity);
        if (ret < 0) {
            LOG_ERR("Failed to get humidity: %d", ret);
            k_sleep(K_SECONDS(5));
            continue;
        }

        /* Update shared data with mutex protection */
        ret = k_mutex_lock(&data_mutex, K_MSEC(500));
        if (ret == 0) {
            latest_reading = data;
            k_mutex_unlock(&data_mutex);
            
            LOG_DBG("Sensor readings updated - Temp: %d.%06d C, Press: %d.%06d kPa, Humidity: %d.%06d %%",
                    data.temp.val1, data.temp.val2,
                    data.press.val1, data.press.val2,
                    data.humidity.val1, data.humidity.val2);
        } else {
            LOG_WRN("Failed to acquire mutex, skipping data update");
        }

        k_sleep(K_SECONDS(5));
    }
}
```

## src/sensor_manager.h
```c
#ifndef SENSOR_MANAGER_H_
#define SENSOR_MANAGER_H_

#include <zephyr/drivers/sensor.h>

struct sensor_reading {
    struct sensor_value temp;
    struct sensor_value press;
    struct sensor_value humidity;
};

void sensor_thread(void);

#endif /* SENSOR_MANAGER_H_ */
```

## src/web_server.c
```c
#include <zephyr/kernel.h>
#include <zephyr/logging/log.h>
#include <zephyr/net/socket.h>
#include <stdio.h>
#include <string.h>
#include <errno.h>
#include "sensor_manager.h"

LOG_MODULE_REGISTER(web_server, LOG_LEVEL_INF);

extern struct sensor_reading latest_reading;
extern struct k_mutex data_mutex;

#define WEB_SERVER_PORT 80
#define RECV_BUF_SIZE 512

static void handle_client(int client)
{
    struct sensor_reading data;
    char response[512];
    char recv_buf[RECV_BUF_SIZE];
    int ret;

    /* Receive HTTP request (basic implementation) */
    ret = recv(client, recv_buf, sizeof(recv_buf) - 1, 0);
    if (ret < 0) {
        LOG_ERR("Failed to receive data from client: %d", errno);
        close(client);
        return;
    }
    recv_buf[ret] = '\0';
    LOG_DBG("Received request: %.*s", (ret > 50 ? 50 : ret), recv_buf);

    /* Get the latest sensor data */
    ret = k_mutex_lock(&data_mutex, K_MSEC(500));
    if (ret == 0) {
        data = latest_reading;
        k_mutex_unlock(&data_mutex);
    } else {
        /* Could not get lock, send error response */
        LOG_WRN("Failed to acquire mutex for sensor data");
        const char *error_response = 
            "HTTP/1.1 503 Service Unavailable\r\n"
            "Content-Type: text/html\r\n\r\n"
            "<html><body><h1>503 Service Unavailable</h1>"
            "<p>Sensor data temporarily unavailable</p></body></html>";
        
        ret = send(client, error_response, strlen(error_response), 0);
        if (ret < 0) {
            LOG_ERR("Failed to send error response: %d", errno);
        }
        close(client);
        return;
    }

    /* Create the HTTP response */
    ret = snprintf(response, sizeof(response),
             "HTTP/1.1 200 OK\r\n"
             "Content-Type: text/html\r\n"
             "Connection: close\r\n\r\n"
             "<!DOCTYPE html>"
             "<html><head><title>Weather Station</title>"
             "<meta http-equiv=\"refresh\" content=\"5\">"
             "</head>"
             "<body style=\"font-family: Arial, sans-serif; margin: 40px;\">"
             "<h1>Environmental Monitor</h1>"
             "<div style=\"background: #f0f0f0; padding: 20px; border-radius: 8px;\">"
             "<p><strong>Temperature:</strong> %d.%06d °C</p>"
             "<p><strong>Pressure:</strong> %d.%06d kPa</p>"
             "<p><strong>Humidity:</strong> %d.%06d %%</p>"
             "</div>"
             "<p style=\"color: #666; font-size: 0.9em;\">Page auto-refreshes every 5 seconds</p>"
             "</body></html>",
             data.temp.val1, data.temp.val2,
             data.press.val1, data.press.val2,
             data.humidity.val1, data.humidity.val2);

    if (ret < 0 || ret >= sizeof(response)) {
        LOG_ERR("Failed to format HTTP response");
        close(client);
        return;
    }

    /* Send the response */
    ret = send(client, response, strlen(response), 0);
    if (ret < 0) {
        LOG_ERR("Failed to send response: %d", errno);
    } else {
        LOG_DBG("Response sent successfully (%d bytes)", ret);
    }

    close(client);
}

void web_server_thread(void)
{
    int server_sock;
    struct sockaddr_in addr;
    int ret;
    int optval = 1;

    /* Create socket */
    server_sock = socket(AF_INET, SOCK_STREAM, IPPROTO_TCP);
    if (server_sock < 0) {
        LOG_ERR("Failed to create socket: %d", errno);
        return;
    }

    /* Set socket options to reuse address */
    ret = setsockopt(server_sock, SOL_SOCKET, SO_REUSEADDR, &optval, sizeof(optval));
    if (ret < 0) {
        LOG_WRN("Failed to set SO_REUSEADDR: %d", errno);
    }

    /* Bind socket */
    addr.sin_family = AF_INET;
    addr.sin_port = htons(WEB_SERVER_PORT);
    addr.sin_addr.s_addr = INADDR_ANY;

    ret = bind(server_sock, (struct sockaddr *)&addr, sizeof(addr));
    if (ret < 0) {
        LOG_ERR("Failed to bind socket to port %d: %d", WEB_SERVER_PORT, errno);
        close(server_sock);
        return;
    }

    /* Listen for connections */
    ret = listen(server_sock, 5);
    if (ret < 0) {
        LOG_ERR("Failed to listen on socket: %d", errno);
        close(server_sock);
        return;
    }

    LOG_INF("Web server listening on port %d", WEB_SERVER_PORT);
    LOG_INF("Connect to http://<device-ip>:%d to view sensor data", WEB_SERVER_PORT);

    /* Accept and handle client connections */
    while (1) {
        struct sockaddr_in client_addr;
        socklen_t client_addr_len = sizeof(client_addr);
        
        int client_sock = accept(server_sock, (struct sockaddr *)&client_addr, &client_addr_len);

        if (client_sock >= 0) {
            LOG_INF("Client connected from %d.%d.%d.%d:%d",
                    (client_addr.sin_addr.s_addr >> 0) & 0xFF,
                    (client_addr.sin_addr.s_addr >> 8) & 0xFF,
                    (client_addr.sin_addr.s_addr >> 16) & 0xFF,
                    (client_addr.sin_addr.s_addr >> 24) & 0xFF,
                    ntohs(client_addr.sin_port));
            
            handle_client(client_sock);
        } else {
            LOG_ERR("Failed to accept connection: %d", errno);
            k_sleep(K_MSEC(100)); /* Brief delay to prevent tight loop on persistent errors */
        }
    }

    /* Cleanup (unreachable in this implementation) */
    close(server_sock);
}
```

## src/web_server.h
```c
#ifndef WEB_SERVER_H_
#define WEB_SERVER_H_

void web_server_thread(void);

#endif /* WEB_SERVER_H_ */
```
